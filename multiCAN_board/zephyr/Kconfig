## multiCAN_board/zephyr/Kconfig
```kconfig
# Copyright (c) 2026 Oleksii Mamontov <mamontov1@gmail.com>
# SPDX-License-Identifier: Apache-2.0

config HEAP_MEM_POOL_ADD_SIZE_BOARD
	int
	default 4096 if BOARD_MULT_CANBRIDGE_ESP32S3_PROCPU
```

## multiCAN_board/zephyr/Kconfig.mult_canbridge
```kconfig
# Copyright (c) 2026 Oleksii Mamontov <mamontov1@gmail.com>
# SPDX-License-Identifier: Apache-2.0

config BOARD_MULT_CANBRIDGE
	select SOC_STM32G473XX if BOARD_MULT_CANBRIDGE_STM32G473XX_MCU1 || \
				  BOARD_MULT_CANBRIDGE_STM32G473XX_MCU2 || \
				  BOARD_MULT_CANBRIDGE_STM32G473XX_MCU3
	select SOC_ESP32S3 if BOARD_MULT_CANBRIDGE_ESP32S3_PROCPU
	select SOC_ESP32S3_PROCPU if BOARD_MULT_CANBRIDGE_ESP32S3_PROCPU
```

## multiCAN_board/zephyr/board.yml
```yaml
board:
  name: mult_canbridge
  full_name: MultBridge
  vendor: canmodule
  socs:
    - name: stm32g473xx
      variants:
        - name: mcu1
        - name: mcu2
        - name: mcu3
    - name: esp32s3
```
