/*
 * Copyright (c) 2026 Oleksii Mamontov <mamontov1@gmail.com>
 * SPDX-License-Identifier: Apache-2.0
 */

/dts-v1/;
#include "mult_canbridge_g473_mcu23.dtsi"

/ {
	model = "MultBridge MCU2";
	compatible = "canmodule,mult-canbridge-mcu2";
};
